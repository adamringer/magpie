## br2-external/Config.in
```kconfig
source "$BR2_EXTERNAL_MAGPIE_PATH/package/snap/Config.in"
source "$BR2_EXTERNAL_MAGPIE_PATH/package/gpsnap/Config.in"
source "$BR2_EXTERNAL_MAGPIE_PATH/package/magpie-usbd/Config.in"
```

## br2-external/configs/magpie_defconfig
```kconfig
BR2_arm=y
BR2_TOOLCHAIN_EXTERNAL=y
BR2_TOOLCHAIN_EXTERNAL_BOOTLIN=y
BR2_TOOLCHAIN_EXTERNAL_BOOTLIN_ARMV5_EABI_MUSL_BLEEDING_EDGE=y
BR2_CCACHE=y
BR2_CCACHE_DIR="$(TOPDIR)/../.ccache"
BR2_GLOBAL_PATCH_DIR="$(BR2_EXTERNAL_MAGPIE_PATH)/patches"
BR2_ROOTFS_POST_IMAGE_SCRIPT="$(BR2_EXTERNAL_MAGPIE_PATH)/board/magpie/post-image.sh"
BR2_PACKAGE_BUSYBOX_CONFIG_FRAGMENT_FILES="$(BR2_EXTERNAL_MAGPIE_PATH)/board/magpie/busybox.fragment"
BR2_TARGET_GENERIC_HOSTNAME="magpie"
BR2_TARGET_GENERIC_ISSUE="Magpie camera"
# BR2_TARGET_GENERIC_REMOUNT_ROOTFS_RW is not set
BR2_ROOTFS_OVERLAY="$(BR2_EXTERNAL_MAGPIE_PATH)/board/magpie/rootfs-overlay"
BR2_ROOTFS_POST_BUILD_SCRIPT="$(BR2_EXTERNAL_MAGPIE_PATH)/board/magpie/post-build.sh"
BR2_ROOTFS_DEVICE_CREATION_DYNAMIC_MDEV=y
# BR2_TARGET_GENERIC_GETTY is not set
BR2_TARGET_ROOTFS_SQUASHFS=y
BR2_TARGET_ROOTFS_SQUASHFS4_XZ=y
# BR2_TARGET_ROOTFS_TAR is not set
BR2_LINUX_KERNEL=y
BR2_LINUX_KERNEL_CUSTOM_VERSION=y
BR2_LINUX_KERNEL_CUSTOM_VERSION_VALUE="6.18.58"
BR2_LINUX_KERNEL_USE_CUSTOM_CONFIG=y
BR2_LINUX_KERNEL_CUSTOM_CONFIG_FILE="$(BR2_EXTERNAL_MAGPIE_PATH)/board/magpie/linux/linux.config"
BR2_LINUX_KERNEL_XZ=y
BR2_LINUX_KERNEL_APPENDED_ZIMAGE=y
BR2_LINUX_KERNEL_DTS_SUPPORT=y
BR2_LINUX_KERNEL_CUSTOM_DTS_PATH="$(BR2_EXTERNAL_MAGPIE_PATH)/board/magpie/linux/at91sam9g25-magpie.dts"
BR2_PACKAGE_SNAP=y
BR2_PACKAGE_GPSNAP=y
BR2_PACKAGE_MAGPIE_USBD=y
# BR2_PACKAGE_IFUPDOWN_SCRIPTS is not set
```

## br2-external/configs/magpie_restore_defconfig
```kconfig
BR2_arm=y
BR2_arm926t=y
BR2_TOOLCHAIN_EXTERNAL=y
BR2_TOOLCHAIN_EXTERNAL_BOOTLIN=y
BR2_TOOLCHAIN_EXTERNAL_BOOTLIN_ARMV5_EABI_MUSL_BLEEDING_EDGE=y
BR2_GLOBAL_PATCH_DIR="$(BR2_EXTERNAL_MAGPIE_PATH)/patches"
# BR2_TARGET_ROOTFS_TAR is not set
BR2_TARGET_UBOOT=y
BR2_TARGET_UBOOT_BUILD_SYSTEM_KCONFIG=y
BR2_TARGET_UBOOT_CUSTOM_VERSION=y
BR2_TARGET_UBOOT_CUSTOM_VERSION_VALUE="2026.07"
BR2_TARGET_UBOOT_BOARD_DEFCONFIG="at91sam9x5ek_mmc"
BR2_TARGET_UBOOT_CONFIG_FRAGMENT_FILES="$(BR2_EXTERNAL_MAGPIE_PATH)/board/magpie/uboot/restore.fragment"
BR2_TARGET_UBOOT_CUSTOM_DTS_PATH="$(BR2_EXTERNAL_MAGPIE_PATH)/board/magpie/uboot/at91sam9g25-magpie.dts"
BR2_TARGET_UBOOT_NEEDS_OPENSSL=y
# BR2_PACKAGE_BUSYBOX is not set
BR2_INIT_NONE=y
# BR2_TARGET_GENERIC_GETTY is not set
```

## br2-external/package/gpsnap/Config.in
```kconfig
config BR2_PACKAGE_GPSNAP
	bool "gpsnap"
	help
	  Raw-sample snapshot capture for the CellGuide ACLYS GPS chip
	  of the Narrative Clip (SPI1 via spidev, GPIO character
	  device). Reproduces the stock aclys_snap tool. Depends only
	  on libc and the kernel UAPI headers.
```

## br2-external/package/magpie-usbd/Config.in
```kconfig
config BR2_PACKAGE_MAGPIE_USBD
	bool "magpie-usbd"
	help
	  FunctionFS USB daemon of the Magpie firmware: serves the
	  photo and capture files in /data/photos, the clock and the
	  status of the Clip to a phone over a vendor-specific bulk
	  interface (WebUSB). Protocol: docs/PHONE_USB.md. Depends
	  only on libc and the kernel UAPI headers.
```

## br2-external/package/snap/Config.in
```kconfig
config BR2_PACKAGE_SNAP
	bool "snap"
	help
	  V4L2 still-capture tool for the Narrative Clip camera
	  (Atmel ISI + OV5640). Depends only on libc and the kernel
	  UAPI headers.
```
